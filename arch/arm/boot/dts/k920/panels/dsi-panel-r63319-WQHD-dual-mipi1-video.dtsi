/* Copyright (c) 2013, The Linux Foundation. All rights reserved.
 *
 * This program is free software; you can redistribute it and/or modify
 * it under the terms of the GNU General Public License version 2 and
 * only version 2 as published by the Free Software Foundation.
 *
 * This program is distributed in the hope that it will be useful,
 * but WITHOUT ANY WARRANTY; without even the implied warranty of
 * MERCHANTABILITY or FITNESS FOR A PARTICULAR PURPOSE.  See the
 * GNU General Public License for more details.
 */

&mdss_mdp {
	dsi_lgd_r63319_WQHD_vid1: qcom,mdss_dsi_r63319_WQHD_dual_mipi1_video {
		compatible = "qcom,mdss-dsi-panel";
		status = "ok";
		qcom,mdss-pan-physical-width-dimension = <75>;
		qcom,mdss-pan-physical-height-dimension = <132>;
		qcom,mdss-dsi-panel-name = "LGD WQHD video mode dsi panel 1";
		qcom,mdss-dsi-panel-controller = <&mdss_dsi1>;
		qcom,mdss-dsi-panel-type = "dsi_video_mode";
		qcom,mdss-dsi-panel-destination = "display_2";
		qcom,mdss-dsi-panel-framerate = <60>;
		qcom,mdss-dsi-virtual-channel-id = <0>;
		qcom,mdss-dsi-stream = <0>;
		qcom,mdss-dsi-panel-width = <720>;
		qcom,mdss-dsi-panel-height = <2560>;
		qcom,mdss-dsi-h-front-porch = <130>;
		qcom,mdss-dsi-h-back-porch = <115>;
		qcom,mdss-dsi-h-pulse-width = <2>;
		qcom,mdss-dsi-h-sync-skew = <0>;
		qcom,mdss-dsi-v-back-porch = <6>;
		qcom,mdss-dsi-v-front-porch = <6>;
		qcom,mdss-dsi-v-pulse-width = <2>;
		qcom,mdss-dsi-h-left-border = <0>;
		qcom,mdss-dsi-h-right-border = <0>;
		qcom,mdss-dsi-v-top-border = <0>;
		qcom,mdss-dsi-v-bottom-border = <0>;
		qcom,mdss-dsi-bpp = <24>;
		qcom,mdss-dsi-color-order = <0>;
		qcom,mdss-dsi-underflow-color = <0xff>;
		qcom,mdss-dsi-border-color = <0>;
		qcom,mdss-dsi-panel-broadcast-mode;
		qcom,mdss-dsi-lp11-init;
		qcom,mdss-dsi-reset-sequence = <1 20>, <0 200>, <1 20>;
		qcom,mdss-dsi-on-command = [
			15 01 00 00 00 00 02 36 00
			15 01 00 00 00 00 02 3A 70
			23 01 00 00 00 00 02 B0 04
			05 01 00 00 00 00 01 00
			05 01 00 00 00 00 01 00
			23 01 00 00 00 00 02 D6 01
			29 01 00 00 00 00 07 B3 14 00 00 00 00 00
			29 01 00 00 00 00 03 B4 0C 00
			29 01 00 00 00 00 03 B6 3A D3
			29 01 00 00 00 00 04 C3 01 00 0f
			29 01 00 00 00 00 07 C0 00 00 00 01 00 00
			29 01 00 00 00 00 24 C1 80 61 c0 21 9D 32 96 7A 30 C2 08 00 00 00 00 10 61 84 4F 2D 41 0C 02 00 00 00 00 00 62 01 08 0A 00 01 11
			29 01 00 00 00 00 09 C2 31 F0 0A 00 08 08 00 00 
			29 01 00 00 00 00 1b C4 70 00 00 33 00 33 33 00 33 00 00 06 03 00 00 00 33 00 33 33 00 33 00 00 01 03
			29 01 00 00 00 00 29 C6 5A 06 50 06 50 00 00 00 00 00 00 00 00 00 00 00 00 13 1A 07 5A 06 50 06 50 00 00 00 00 00 00 00 00 00 00 00 00 13 1A 07
			29 01 00 00 00 00 0b CB 1F 0F F0 F8 40 00 00 02 C0 00
			29 01 00 00 00 00 02 CC 1E 
			29 01 00 00 00 00 18 CE 75 40 48 56 67 78 88 98 A7 B5 C3 D1 DE E9 F2 FA FF 0F 00 0A 07 44 04
			29 01 00 00 00 00 03 D2 00 00
			29 01 00 00 00 00 18 D7 84 F0 7F A8 CE 38 FC C1 18 E7 8F 1F 3C 10 FA C3 0F 04 41 00 00 00 00
			29 01 00 00 00 00 04 D9 00 00 00
			29 01 00 00 00 00 1f C7 02 12 19 22 2F 3D 46 55 39 40 4B 58 69 72 7C 09 10 19 22 2F 3D 46 55 39 40 4B 58 6A 75 7F
			29 01 00 00 00 00 14 C8 01 00 00 00 00 FC 00 00 00 00 00 FC 00 00 00 00 00 FC 00
			29 01 00 00 00 00 0b D0 35 81 BB 19 9A 4C 19 19 0C 00
			29 01 00 00 00 00 1a D3 1B 33 BB AB A3 33 33 33 00 01 00 A0 F8 A0 0F 47 49 22 3B 37 72 07 3D BF 33
			29 01 00 00 00 00 08 D5 06 00 00 01 35 01 35
			15 01 00 00 00 00 02 35 00
			15 01 00 00 00 00 02 53 2c
			05 01 00 00 28 00 01 29
			05 01 00 00 78 00 01 11
		];
		qcom,mdss-dsi-off-command = [
			05 01 00 00 14 00 01 28
			29 05 00 00 32 00 29 C6 5A 06 50 06 00 00 00 00 00 00 00 00 00 00 00 00 00 13 1A 07 5A 06 50 06 00 00 00 00 00 00 00 00 00 00 00 00 00 13 1A 07
			29 05 00 00 32 00 08 D5 06 00 00 00 48 00 48
			05 01 00 00 50 00 01 10
		];
		qcom,mdss-dsi-on-command-state = "dsi_lp_mode";
		qcom,mdss-dsi-off-command-state = "dsi_hs_mode";
		qcom,mdss-dsi-h-sync-pulse = <0>;
		qcom,mdss-dsi-traffic-mode = "non_burst_sync_event";
		qcom,mdss-dsi-lane-map = <0>;
		qcom,mdss-dsi-bllp-eof-power-mode;
		qcom,mdss-dsi-bllp-power-mode;
		qcom,mdss-dsi-lane-0-state;
		qcom,mdss-dsi-lane-1-state;
		qcom,mdss-dsi-lane-2-state;
		qcom,mdss-dsi-lane-3-state;
		qcom,mdss-dsi-panel-timings = [
			ef 38 25 00 67 70  
			29 3c 2c 03 04 00
		];
		qcom,mdss-dsi-t-clk-post = <0x20>;
		qcom,mdss-dsi-t-clk-pre = <0x3e>;
		qcom,mdss-dsi-bl-min-level = <1>;
		qcom,mdss-dsi-bl-max-level = <255>;
		qcom,mdss-dsi-dma-trigger = "trigger_sw";
		qcom,mdss-dsi-mdp-trigger = "none";
		qcom,mdss-dsi-bl-pmic-control-type = "bl_ctrl_dcs";
		qcom,mdss-dsi-pan-enable-dynamic-fps;
		qcom,mdss-dsi-pan-fps-update = "dfps_immediate_porch_mode";
		qcom,mdss-dsi-min-refresh-rate = <45>;
		qcom,mdss-dsi-max-refresh-rate = <60>;
		qcom,cont-splash-enabled;
		qcom,ulps-enabled;
	};
};
