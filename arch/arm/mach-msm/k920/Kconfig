## arch/arm/mach-msm/k920/Kconfig
```kconfig
# Lenovo configuration options

config MACH_LENOVO_K920
	bool "Lenovo K920 board"
	help
	  Support for Lenovo K920
```

## drivers/input/touchscreen/s3408/Kconfig
```kconfig
#
# Synaptics s3408 DSX I2C touchscreen driver
#

config TOUCHSCREEN_SYNAPTICS_S3408_FW_UPDATE
	tristate "Synaptics s3408 DSX I2C touchscreen firmware update"
	depends on TOUCHSCREEN_SYNAPTICS_S3408
	default n
	help
	  This enables support for firmware update for Synaptics
	  s3408 DSX I2C touchscreen.

	  If unsure, say N.
```

## drivers/platform/lenovo/Kconfig
```kconfig
# Lenovo configuration options

config MACH_LENOVO_K920
	bool "K920 board"
	help
		Support for Lenovo K920
```
